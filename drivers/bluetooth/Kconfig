## drivers/bluetooth/Kconfig
```kconfig
# Bluetooth LE driver configuration options

# Copyright (c) 2015-2016 Intel Corporation
# SPDX-License-Identifier: Apache-2.0

#
# Bluetooth options
#

# Controller support is an HCI driver in itself, so these HCI driver
# options are only applicable if controller support hasn't been enabled.
menu "Bluetooth Drivers"
	depends on BT && !BT_CTLR

if BT_HCI
source "drivers/bluetooth/hci/Kconfig"
endif

if BT_CUSTOM
# Insert here any custom (non-HCI) offload drives
endif

endmenu

config BT_SHMEM_NRF53_FIFO
	bool "Enable shared memory FIFO on nRF53 API"
	depends on SOC_NRF5340_CPUNET
	select IPM
	select IPM_NRFX
	select IPM_MSG_CH_0_ENABLE
	select IPM_MSG_CH_0_TX
	select IPM_MSG_CH_1_ENABLE
	select IPM_MSG_CH_1_RX
	select IPM_MSG_CH_2_ENABLE
	select IPM_MSG_CH_2_RX
	select IPM_MSG_CH_3_ENABLE
	select IPM_MSG_CH_3_TX
	help
	  Enable shared memory FIFO API to communicate with "HCI over shared
	  memory FIFO on nRF53" driver. This API is needed to implement
	  controller side of HCI.
```

## drivers/net/Kconfig.rtt
```kconfig
menuconfig NET_RTT
	select HAS_SEGGER_RTT
	select RTT_CONSOLE
	select NET_L2_ETHERNET
	bool "Ethernet driver over RTT"

if NET_RTT

config NET_RTT_SOME
	bool "Some option"

endif
```

## subsys/ipc/ipc_service/backends/Kconfig.icbmsg
```kconfig
# Copyright (c) 2023 Nordic Semiconductor ASA
# SPDX-License-Identifier: Apache-2.0

menuconfig IPC_SERVICE_BACKEND_ICBMSG
	bool "ICMSG backend with dynamically allocated buffers"
	default y
	depends on MBOX
	depends on DT_HAS_ZEPHYR_IPC_ICBMSG_ENABLED
	select IPC_SERVICE_ICMSG
	help
	  Choosing this backend results in multi endpoint implementation based
	  on dynamically allocated buffers. References to them are send over
	  ICMsg circular buffer.

if IPC_SERVICE_BACKEND_ICBMSG

config IPC_SERVICE_BACKEND_ICBMSG_NUM_EP
	int "Endpoints count"
	range 1 254
	default 4
	help
	  Number of endpoints supported by the ICBMsg IPC service
	  backend. The number of endpoints are applied to all the instances,
	  so this value should be maximum number among all the instances.

config IPC_SERVICE_BACKEND_ICBMSG_CACHE_ALIGN
	bool "Align block with cache lines"
	default y
	help
	  Enable alignment of the blocks to the cache lines.
	  This is required if the receiver core can flush its cache or it is flushed
	  automatically. You can disable this option if your architecture and software
	  ensures that it will not modify content of the received blocks.
	  The SPSC_PBUF_REMOTE_DCACHE_LINE configures the remote cache line.

module = IPC_SERVICE_BACKEND_ICBMSG
module-str = ICMSG backend with separate buffers
module-help = Sets log level for ICMsg backend with buffers
source "subsys/logging/Kconfig.template.log_config"

endif # IPC_SERVICE_BACKEND_ICBMSG
```

## subsys/ipc/ipc_service/backends/Kconfig.icmsg_with_buf
```kconfig
# Copyright (c) 2023 Nordic Semiconductor ASA
# SPDX-License-Identifier: Apache-2.0

if IPC_SERVICE_BACKEND_ICMSG_WITH_BUF

config IPC_SERVICE_BACKEND_ICMSG_WITH_BUF_NUM_EP
	int "Endpoints number"
	range 1 251
	default 4
	help
	  Number of endpoints supported by the ICMsg with buffers IPC service
	  backend. The number of endpoints are applied to all the instances,
	  so this value should be maximum number among all the instances.

module = IPC_SERVICE_BACKEND_ICMSG_WITH_BUF
module-str = ICMSG backend with separate buffers
module-help = Sets log level for ICMsg backend with buffers
source "subsys/logging/Kconfig.template.log_config"

endif # IPC_SERVICE_BACKEND_ICMSG_WITH_BUF
```
